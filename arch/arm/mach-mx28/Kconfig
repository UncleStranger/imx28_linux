## arch/arm/mach-mx28/Kconfig
```kconfig
choice
	prompt "Select i.MXS board type"

config MACH_MX28EVK
	bool "Freescale MX28 EVK board"
	depends on ARCH_MX28
	select USB_ARCH_HAS_EHCI

endchoice

config MXS_ORION28
	bool "ZEO MX28 ORION28 board"
	depends on ARCH_MX28	

config VECTORS_PHY_ADDR
	int "vectors address"
	default 0
	help
	  This config set vectors table is located which physical address

config MXS_TIMER_WITH_MACH
	bool "System Timer support Compare Match interrupt"
	default y

config MEM_mDDR
	bool "Memory type is mDDR"
	depends on ARCH_MX28
	help
	  Say Y to select mDDR memory
	  
config MX28_ENET_ISSUE
	bool "Enable MX28 enet issue fix - Read help!"
	depends on ARCH_MX28
	help
		Say Y to enable a fix for link up/down issue on mx28.
		It is STRONGLY! recommended to always have external oscillators
		provide the clock to ENET PHY and FEC unit.
```
